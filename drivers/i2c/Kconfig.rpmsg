## drivers/i2c/Kconfig.rpmsg
```kconfig
# Kconfig - I2C EEPROM Slave configuration options

#
# Copyright (c) 2017 BayLibre, SAS
#
# SPDX-License-Identifier: Apache-2.0
#

config I2C_RPMSG
	bool "I2C Slave RPMSG driver"
	select CONFIG_OPENAMP
	default n
	help
	  Enable virtual I2C Slave RPMSG driver
```

## dts/bindings/i2c/rpmsg-i2c.yaml
```yaml
# Copyright (c) 2019 ST MICROELECTRONIC
# SPDX-License-Identifier: Apache-2.0

title: RPMSG I2C

description: >
    This binding gives a virtual support of I2C over RPMsg

compatible: "rpmsg-i2c"

include: i2c-controller.yaml
```

## dts/bindings/ipm/st,stm32-ipcc-mailbox.yaml
```yaml
---
# SPDX-License-Identifier: Apache-2.0
title: STM32 MAILBOX
version: 0.1

description: >
  This binding gives a base representation of the STM32 IPCC

inherits:
    !include base.yaml

properties:
  clocks:
    type: array
    category: required
    description: Clock gate control information
    generation: define
```

## lib/open-amp/Kconfig
```kconfig
#
# Copyright (c) 2019, STMicroelectronics
#
# SPDX-License-Identifier: Apache-2.0
#

source "lib/open-amp/rsc_table/Kconfig"
```

## lib/open-amp/rsc_table/Kconfig
```kconfig
#
# Copyright (c) 2019, STMicroelectronics
#
# SPDX-License-Identifier: Apache-2.0
#

config RSC_TABLE
	bool "coprocessor resource table"
	imply OPENAMP
	help
	  add the resource table in the generated binary. This table is
	  compatible with linux remote proc framework and OpenAMP library.

config RSC_TABLE_NUM_RPMSG_BUFF
	int "Resource table number of rpmsg buffers"
	default 0
	depends on RSC_TABLE
	help
	  This option specifies the number of buffer used in a Vring for
	  interprocessor communication
```
